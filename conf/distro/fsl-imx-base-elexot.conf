## conf/distro/fsl-imx-base-elexot.conf
```bitbake
include conf/distro/include/fsl-imx-base.inc
include conf/distro/include/fsl-imx-preferred-env.inc

DISTRO = "fsl-imx-base-elexot"

PREFERRED_PROVIDER_virtual/kernel:imx-nxp-bsp = "linux-elexot"
PREFERRED_PROVIDER_virtual/bootloader:imx-nxp-bsp = "u-boot-elexot"

IMAGE_FSTYPES += " wic.gz wic.sparse"
IMAGE_CLASSES += " image_types_sparse"
```

## conf/machine/elexotn91.conf
```bitbake
#@TYPE: Machine
#@NAME: Elexot N91 based platforms
#@SOC: i.MX91
#@DESCRIPTION: Machine configuration for Elexot N91
#@MAINTAINER:  <@>

MACHINEOVERRIDES =. "mx91:"

IMX_DEFAULT_BSP ?= "nxp"

require conf/machine/include/imx-base.inc
require conf/machine/include/arm/armv8-2a/tune-cortexa55.inc

# Kernel configuration
PREFERRED_PROVIDER_virtual/kernel ??= "linux-elexot"
KERNEL_DEVICETREE = " \
    freescale/imx91-tap2id.dtb \
"
KERNEL_IMAGETYPE = "Image"
RRECOMMENDS:${KERNEL_PACKAGE_NAME}-base = ""

# U-Boot configuration
IMX_DEFAULT_BOOTLOADER:imx-nxp-bsp = "u-boot-elexot"
PREFERRED_PROVIDER_u-boot ??= "u-boot-elexot"
PREFERRED_PROVIDER_virtual/bootloader ??= "u-boot-elexot"
LOADADDR = ""
SPL_BINARY = "spl/u-boot-spl.bin"
UBOOT_DTB_NAME = "imx91-tap2id.dtb"
UBOOT_MAKE_TARGET = ""
UBOOT_SUFFIX = "bin"
UBOOT_CONFIG ??= "sd"
UBOOT_CONFIG[sd]     = "imx91_tap2id_defconfig,sdcard"

ATF_PLATFORM = "imx91"

DDR_FIRMWARE_NAME = " \
    lpddr4_dmem_1d_v202201.bin \
    lpddr4_dmem_2d_v202201.bin \
    lpddr4_imem_1d_v202201.bin \
    lpddr4_imem_2d_v202201.bin \
"

IMXBOOT_TARGETS = "flash_singleboot"
IMX_BOOT_SOC_TARGET = "iMX91"
IMX_BOOT_SEEK = "32"

IMAGE_BOOT_FILES:append = " \
	boot.scr-${MACHINE};boot.scr \
	upgrade.scr-${MACHINE};upgrade.scr \
	imx-boot-${MACHINE}-sd.bin-flash_singleboot;u-boot.imx91_tap2id \
"

# wic support
WKS_FILE = "sdimage-bootpart.wks"
WKS_FILE_DEPENDS += "u-boot-script-elexot"

SERIAL_CONSOLES = "115200;ttyLP0"
```
